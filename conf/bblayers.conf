## conf/bblayers.conf
```bitbake
# POKY_BBLAYERS_CONF_VERSION is increased each time build/conf/bblayers.conf
# changes incompatibly
POKY_BBLAYERS_CONF_VERSION = "2"

BBPATH = "${TOPDIR}"
BSPDIR := "${@os.path.abspath(os.path.dirname(d.getVar('FILE', True)) + '/../..')}"

BBFILES ?= ""
BBLAYERS ?= " \
  ${BSPDIR}/sources/poky/meta \
  ${BSPDIR}/sources/poky/meta-poky \
  ${BSPDIR}/sources/solidrun/meta-solidrun-bsp \
  ${BSPDIR}/sources/freescale/meta-freescale \
  ${BSPDIR}/sources/common/meta-openembedded/meta-oe \
  ${BSPDIR}/sources/common/meta-openembedded/meta-python \
  ${BSPDIR}/sources/common/meta-openembedded/meta-networking \
  ${BSPDIR}/sources/gco/meta-v2x \
  "
```
